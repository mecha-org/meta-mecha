## conf/distro/mecha-wayland.conf
```bitbake
# Mecha DISTRO for Wayland without X11

include conf/distro/include/fsl-imx-base.inc
include conf/distro/include/fsl-imx-preferred-env.inc

MACHINEOVERRIDES_EXTENDER:mx8mm:use-nxp-bsp  = "imx-generic-bsp:imx-nxp-bsp:imxdrm:imxvpu:etnaviv:mx8-generic-bsp:mx8-nxp-bsp:mx8m-generic-bsp:mx8m-nxp-bsp:mx8mm-generic-bsp:mx8mm-nxp-bsp"

PREFERRED_VERSION_weston:imx-nxp-bsp = "10.0.2"
PREFERRED_VERSION_wayland-protocols:mx9-nxp-bsp = "1.25"

DISTRO = "mecha-wayland"

# Remove conflicting backends
DISTRO_FEATURES:remove = " directfb"
DISTRO_FEATURES:append = " x11 wayland pam systemd"

#DISTRO_FEATURES:append = " connman"     
# DISTRO_FEATURES:append = " mesa mesa-demos"     
# DISTRO_FEATURES:append = " bluez5"     
# DISTRO_FEATURES:append = " pulseaudio"     
 
```

## conf/distro/mechanix-xwayland.conf
```bitbake
# Mecha DISTRO for Wayland without X11

include conf/distro/include/fsl-imx-base.inc
include conf/distro/include/fsl-imx-preferred-env.inc

MACHINEOVERRIDES_EXTENDER:mx8mm:use-nxp-bsp  = "imx-generic-bsp:imx-nxp-bsp:imxdrm:imxvpu:etnaviv:mx8-generic-bsp:mx8-nxp-bsp:mx8m-generic-bsp:mx8m-nxp-bsp:mx8mm-generic-bsp:mx8mm-nxp-bsp"

#PREFERRED_VERSION_weston:imx-nxp-bsp = "10.0.2"
#PREFERRED_VERSION_wayland-protocols:mx9-nxp-bsp = "1.32"

DISTRO = "mechanix-xwayland"

# Remove conflicting backends
DISTRO_FEATURES:remove = " directfb vulkan"
DISTRO_FEATURES:append = " opengl x11 wayland pam systemd polkit"

# Make var/log/* data persistent 
# [It will store kernel log data from the boards first boot, to non-volatile memory] 
VOLATILE_LOG_DIR = "no"

# Requirs meta-rust71 layer [rust 1.71 version]
# PREFERRED_VERSION_libstd-rs = "1.72.0"
# PREFERRED_VERSION_rust = "1.72.0"
# PREFERRED_VERSION_rust-native = "1.72.0"
# PREFERRED_VERSION_rust-cross = "1.72.0"
# PREFERRED_VERSION_rust-cross-canadian = "1.72.0"
# PREFERRED_VERSION_rust-llvm = "1.72.0"
# PREFERRED_VERSION_rust-llvm-native = "1.72.0"
# PREFERRED_VERSION_rust-tools-cross-canadian = "1.72.0"
# PREFERRED_VERSION_rust-cross-armv8a-glibc = "1.72.0"

# PREFERRED_VERSION_cargo = "1.72.0"
# PREFERRED_VERSION_cargo-native = "1.72.0"
# PREFERRED_VERSION_cargo-cross-canadian = "1.72.0"

# PREFERRED_VERSION_wayland-protocols = "1.32"
# PREFERRED_VERSION_wayland = "1.21.0"
# PREFERRED_VERSION_wayland-protocols = "1.32"
# PREFERRED_VERSION_wayland-protocols-native = "1.32"
# PREFERRED_VERSION_wayland-utils = "1.1.0"
# PREFERRED_VERSION_libdrm = "2.4.113"
# PREFERRED_VERSION_libinput = "1.22.1"

# PREFERRED_VERSION_wayland-protocols:forcevariable = "1.32"
# PREFERRED_VERSION_wayland:forcevariable = "1.21.0"
# PREFERRED_VERSION_wayland-protocols:forcevariable = "1.32"
# PREFERRED_VERSION_wayland-protocols-native:forcevariable = "1.32"
# PREFERRED_VERSION_wayland-utils:forcevariable = "1.1.0"
# PREFERRED_VERSION_libdrm:forcevariable = "2.4.110"
# PREFERRED_VERSION_libinput:forcevariable = "1.22.1"

# PREFERRED_VERSION_gstreamer1.0:mx8-nxp-bsp              = "1.20.3"
# PREFERRED_VERSION_gstreamer1.0-plugins-base:mx8-nxp-bsp = "1.20.3"
# PREFERRED_VERSION_gstreamer1.0-plugins-good:mx8-nxp-bsp = "1.20.3"
# PREFERRED_VERSION_gstreamer1.0-plugins-bad:mx8-nxp-bsp  = "1.20.3"
```

## conf/layer.conf
```bitbake
# We have a conf and classes directory, add to BBPATH
BBPATH .= ":${LAYERDIR}"

# We have recipes-* directories, add to BBFILES
BBFILES += "${LAYERDIR}/recipes-*/*/*.bb \
            ${LAYERDIR}/recipes-*/*/*.bbappend"

BBFILE_COLLECTIONS += "meta-mecha"
BBFILE_PATTERN_meta-mecha = "^${LAYERDIR}/"
BBFILE_PRIORITY_meta-mecha = "6"

LAYERDEPENDS_meta-mecha = "core"
LAYERSERIES_COMPAT_meta-mecha = "kirkstone"
```
